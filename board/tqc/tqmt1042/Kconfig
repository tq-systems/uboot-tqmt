## board/tqc/tqmt1042/Kconfig
```kconfig
if TARGET_TQMT1042

config SYS_BOARD
	default "tqmt1042"

config SYS_VENDOR
	default "tqc"

config SYS_CONFIG_NAME
	default "TQMT1042"

choice
	prompt "TQMT1042 RCW configuration file"
	default RCW_CFG_TQMT1042_SERDES86
	help
	  select the RCW configuration file to be used for TQMT1042

config RCW_CFG_TQMT1042_SERDES86
	bool "RCW configuration for SERDES mode = 86, default RCW configuration"
	help
	  Select SERDES mode = 86 in reset configuration word.

config RCW_CFG_TQMT1042_SERDES88
	bool "RCW configuration for SERDES mode = 88"
	help
	  Select SERDES mode = 88 in reset configuration word.

config RCW_CFG_TQMT1042_SERDES8E
	bool "RCW configuration for SERDES mode = 8E"
	help
	  Select SERDES mode = 8E in reset configuration word.

endchoice

config SYS_FSL_RCW
	string
	default "board/tqc/tqmt1042/tqmt1042_serdes86_rcw.cfg" if RCW_CFG_TQMT1042_SERDES86
	default "board/tqc/tqmt1042/tqmt1042_serdes88_rcw.cfg" if RCW_CFG_TQMT1042_SERDES88
	default "board/tqc/tqmt1042/tqmt1042_serdes8e_rcw.cfg" if RCW_CFG_TQMT1042_SERDES8E
endif
```

## board/tqc/tqmt104x/Kconfig
```kconfig
if TARGET_TQMT1022 || TARGET_TQMT1040 || TARGET_TQMT1042

config SYS_BOARD
	default "tqmt104x"

config SYS_VENDOR
	default "tqc"

config SYS_CONFIG_NAME
	default "TQMT1022" if TARGET_TQMT1022
	default "TQMT1040" if TARGET_TQMT1040
	default "TQMT1042" if TARGET_TQMT1042
	
choice
	prompt "TQMT104x RCW configuration file"
	default RCW_CFG_TQMT1042_SERDES86 if TARGET_TQMT1022
	default RCW_CFG_TQMT1040_SERDES66 if TARGET_TQMT1040
	default RCW_CFG_TQMT1042_SERDES86 if TARGET_TQMT1042
	help
	  select the RCW configuration file to be used for TQMT104x

config RCW_CFG_TQMT1042_SERDES86
	bool "TQMT1042 RCW configuration for SERDES mode = 86, default RCW configuration"
	help
	  Select SERDES mode = 86 in reset configuration word.

config RCW_CFG_TQMT1042_SERDES88
	bool "TQMT1042 RCW configuration for SERDES mode = 88"
	help
	  Select SERDES mode = 88 in reset configuration word.

config RCW_CFG_TQMT1042_SERDES8E
	bool "TQMT1042 RCW configuration for SERDES mode = 8E"
	help
	  Select SERDES mode = 8E in reset configuration word.

config RCW_CFG_TQMT1040_SERDES66
        bool "TQMT1040 RCW configuration for SERDES mode = 66, default RCW configuration"
        help
          Select SERDES mode = 66 in reset configuration word.

endchoice

config SYS_FSL_RCW
	string
	default "board/tqc/tqmt104x/tqmt1042_serdes86_rcw.cfg" if RCW_CFG_TQMT1042_SERDES86
	default "board/tqc/tqmt104x/tqmt1042_serdes88_rcw.cfg" if RCW_CFG_TQMT1042_SERDES88
	default "board/tqc/tqmt104x/tqmt1042_serdes8e_rcw.cfg" if RCW_CFG_TQMT1042_SERDES8E
	default "board/tqc/tqmt104x/tqmt1040_serdes66_rcw.cfg" if RCW_CFG_TQMT1040_SERDES66
endif
```

## board/tqc/tqmt2081/Kconfig
```kconfig
if TARGET_TQMT2081

config SYS_BOARD
	default "tqmt2081"

config SYS_VENDOR
	default "tqc"

config SYS_CONFIG_NAME
	default "TQMT2081"

choice
        prompt "TQMT2081 RCW configuration file"
        default RCW_CFG_TQMT2081_SERDES71
        help
          select the RCW configuration file to be used for TQMT2081

config RCW_CFG_TQMT2081_SERDES71
        bool "TQMT2081 RCW configuration for SERDES mode = 71, default RCW configuration"
        help
          Select SERDES mode = 71 in reset configuration word.

config RCW_CFG_TQMT2081_SERDESF2
        bool "TQMT2081 RCW configuration for SERDES mode = F2"
        help
          Select SERDES mode = F2 in reset configuration word.

endchoice

config SYS_FSL_RCW
        string
        default "board/tqc/tqmt2081/tqmt2081_serdes71_rcw.cfg" if RCW_CFG_TQMT2081_SERDES71
        default "board/tqc/tqmt2081/tqmt2081_serdesf2_rcw.cfg" if RCW_CFG_TQMT2081_SERDESF2

endif
```

## configs/TQMT1024_SDCARD_defconfig
```kconfig
CONFIG_PPC=y
CONFIG_MPC85xx=y
CONFIG_TARGET_TQMT1024=y
CONFIG_SPL=y
CONFIG_SYS_EXTRA_OPTIONS="PPC_T1024,TQMT1024,RAMBOOT_PBL,SPL_FSL_PBL,SDCARD"
```

## configs/TQMT1024_defconfig
```kconfig
CONFIG_PPC=y
CONFIG_MPC85xx=y
CONFIG_TARGET_TQMT1024=y
CONFIG_SYS_EXTRA_OPTIONS="PPC_T1024,TQMT1024"
```

## configs/TQMT1040_SDCARD_defconfig
```kconfig
CONFIG_PPC=y
CONFIG_MPC85xx=y
CONFIG_TARGET_TQMT1040=y
CONFIG_SPL=y
CONFIG_SYS_EXTRA_OPTIONS="PPC_T1042,TQMT1040,RAMBOOT_PBL,SPL_FSL_PBL,SDCARD"
```

## configs/TQMT1042_SDCARD_defconfig
```kconfig
CONFIG_PPC=y
CONFIG_MPC85xx=y
CONFIG_TARGET_TQMT1042=y
CONFIG_SPL=y
CONFIG_SYS_EXTRA_OPTIONS="PPC_T1042,TQMT1042,RAMBOOT_PBL,SPL_FSL_PBL,SDCARD"
```

## configs/TQMT1042_SDCARD_serdes88_defconfig
```kconfig
CONFIG_PPC=y
CONFIG_MPC85xx=y
CONFIG_TARGET_TQMT1042=y
CONFIG_SPL=y
CONFIG_SYS_EXTRA_OPTIONS="PPC_T1042,TQMT1042,RAMBOOT_PBL,SPL_FSL_PBL,SDCARD"
CONFIG_RCW_CFG_TQMT1042_SERDES88=y
```

## configs/TQMT1042_defconfig
```kconfig
CONFIG_PPC=y
CONFIG_MPC85xx=y
CONFIG_TARGET_TQMT1042=y
CONFIG_SYS_EXTRA_OPTIONS="PPC_T1042,TQMT1042"
```

## configs/TQMT1042_serdes88_defconfig
```kconfig
CONFIG_PPC=y
CONFIG_MPC85xx=y
CONFIG_TARGET_TQMT1042=y
CONFIG_SYS_EXTRA_OPTIONS="PPC_T1042,TQMT1042"
CONFIG_RCW_CFG_TQMT1042_SERDES88=y
```
